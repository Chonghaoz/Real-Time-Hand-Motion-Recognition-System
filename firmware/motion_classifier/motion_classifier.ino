#include <Wire.h>
#include <math.h>
#include <TFT_eSPI.h>
#include <SPI.h>

#define QMI8658_ADDR 0x6B

#define CTRL1 0x02
#define CTRL2 0x03
#define CTRL3 0x04
#define CTRL7 0x08
#define AX_L  0x35

const float alpha = 0.2f;
const float gravityAlpha = 0.05f;
const int WINDOW_SIZE = 5;

// ===== IMU state =====
float fax = 0, fay = 0, faz = 0;
float fgx = 0, fgy = 0, fgz = 0;

float gravx = 0, gravy = 0, gravz = 0;

float lastGyroMag = 0.0f;
float lastLinAccMag = 0.0f;

float gyroWindow[WINDOW_SIZE];
float linAccWindow[WINDOW_SIZE];
float linAxWindow[WINDOW_SIZE];
float linAyWindow[WINDOW_SIZE];
float linAzWindow[WINDOW_SIZE];

int windowIndex = 0;
bool windowFilled = false;

// Model parameters generated by training/export_tree.py
#include "model_data.h"

const int VOTE_SIZE = 3;
int predBuffer[VOTE_SIZE];
int predIndex = 0;
bool predFilled = false;

int stableClass = 2;          // default STILL
int candidateClass = -1;
int candidateCount = 0;

const int CHANGE_CONFIRM_COUNT = 3;

unsigned long lastOngoingPrint = 0;
const unsigned long ONGOING_INTERVAL = 1000;

TFT_eSPI tft = TFT_eSPI();

int lastDrawnClass = -1;
int animFrame = 0;
unsigned long lastAnimTime = 0;
const unsigned long ANIM_INTERVAL = 120; 

void writeRegister(uint8_t reg, uint8_t val) {
  Wire.beginTransmission((uint8_t)QMI8658_ADDR);
  Wire.write(reg);
  Wire.write(val);
  Wire.endTransmission();
}

int16_t read16(uint8_t reg) {
  Wire.beginTransmission((uint8_t)QMI8658_ADDR);
  Wire.write(reg);
  Wire.endTransmission(false);
  Wire.requestFrom((uint8_t)QMI8658_ADDR, (uint8_t)2);

  uint8_t low = 0, high = 0;
  if (Wire.available()) low = Wire.read();
  if (Wire.available()) high = Wire.read();

  return (int16_t)((high << 8) | low);
}

void setupIMU() {
  writeRegister(CTRL1, 0x40);
  delay(50);
  writeRegister(CTRL2, 0x15);
  writeRegister(CTRL3, 0x35);
  writeRegister(CTRL7, 0x03);
  delay(50);
}

void readIMU(float &ax, float &ay, float &az, float &gx, float &gy, float &gz) {
  ax = read16(AX_L) / 16384.0f;
  ay = read16(AX_L + 2) / 16384.0f;
  az = read16(AX_L + 4) / 16384.0f;

  gx = read16(AX_L + 6) / 64.0f;
  gy = read16(AX_L + 8) / 64.0f;
  gz = read16(AX_L + 10) / 64.0f;
}

int predictClass(const float raw_features[FEATURE_COUNT]) {
  float scaled[FEATURE_COUNT];

  for (int i = 0; i < FEATURE_COUNT; i++) {
    scaled[i] = (raw_features[i] - mean_vals[i]) / scale_vals[i];
  }

  int node = 0;
  while (!is_leaf[node]) {
    int f = feature[node];
    if (scaled[f] <= threshold[node]) {
      node = left[node];
    } else {
      node = right[node];
    }
  }

  return node_class[node];
}

const char* className(int cls) {
  switch (cls) {
    case 0: return "ROTATE";
    case 1: return "SHAKE";
    case 2: return "STILL";
    case 3: return "TRANSLATE";
    default: return "UNKNOWN";
  }
}

void setupScreen() {
  tft.init();
  tft.setRotation(0);
  tft.fillScreen(TFT_BLACK);
  tft.setTextDatum(MC_DATUM);
  tft.setTextColor(TFT_WHITE, TFT_BLACK);
}

void drawLabel(const char* text) {
  tft.setTextSize(2);
  tft.drawString(text, tft.width() / 2, tft.height() - 28);
}

void drawStillIcon() {
  int cx = tft.width() / 2;
  int cy = tft.height() / 2 - 20;

  tft.fillCircle(cx, cy, 12, TFT_GREEN);
  tft.drawCircle(cx, cy, 18, TFT_DARKGREEN);
}

void drawShakeIcon(int frame) {
  int cx = tft.width() / 2;
  int cy = tft.height() / 2 - 20;

  int offset = (frame % 2 == 0) ? -10 : 10;

  tft.fillCircle(cx, cy, 8, TFT_RED);

  tft.drawLine(cx - 30 + offset, cy - 12, cx - 8 + offset, cy - 12, TFT_YELLOW);
  tft.drawLine(cx - 30 - offset, cy,      cx - 8 - offset, cy,      TFT_YELLOW);
  tft.drawLine(cx - 30 + offset, cy + 12, cx - 8 + offset, cy + 12, TFT_YELLOW);
}

void drawRotateIcon(int frame) {
  int cx = tft.width() / 2;
  int cy = tft.height() / 2 - 20;
  int r = 24;

  float angle = (frame * 18) * 3.1415926f / 180.0f;

  tft.drawCircle(cx, cy, r, TFT_CYAN);

  int x = cx + (int)(r * cos(angle));
  int y = cy + (int)(r * sin(angle));

  tft.fillCircle(x, y, 5, TFT_CYAN);

  tft.fillCircle(cx, cy, 3, TFT_BLUE);
}

void drawTranslateIcon(int frame) {
  int cx = tft.width() / 2;
  int cy = tft.height() / 2 - 20;

  int offset = (frame % 3) * 8 - 8;

  tft.drawLine(cx - 40, cy, cx + 40, cy, TFT_MAGENTA);

  int ax = cx + offset;
  tft.fillTriangle(
    ax + 16, cy,
    ax - 8, cy - 10,
    ax - 8, cy + 10,
    TFT_MAGENTA
  );
}

void drawActionScreen(int action) {
  tft.fillScreen(TFT_BLACK);

  switch (action) {
    case 0:
      drawRotateIcon(animFrame);
      drawLabel("ROTATING...");
      break;

    case 1:
      drawShakeIcon(animFrame);
      drawLabel("SHAKING...");
      break;

    case 2:
      drawStillIcon();
      drawLabel("STILL");
      break;

    case 3:
      drawTranslateIcon(animFrame);
      drawLabel("TRANSLATING...");
      break;

    default:
      drawLabel("UNKNOWN");
      break;
  }
}

void updateScreen() {
  unsigned long now = millis();

  if (now - lastAnimTime < ANIM_INTERVAL) return;
  lastAnimTime = now;

  animFrame++;
  drawActionScreen(stableClass);
}

int majorityVote(int pred) {
  predBuffer[predIndex] = pred;
  predIndex++;

  if (predIndex >= VOTE_SIZE) {
    predIndex = 0;
    predFilled = true;
  }

  int countSize = predFilled ? VOTE_SIZE : predIndex;
  int counts[4] = {0, 0, 0, 0};

  for (int i = 0; i < countSize; i++) {
    if (predBuffer[i] >= 0 && predBuffer[i] < 4) {
      counts[predBuffer[i]]++;
    }
  }

  int bestClass = 0;
  int bestCount = counts[0];
  for (int i = 1; i < 4; i++) {
    if (counts[i] > bestCount) {
      bestCount = counts[i];
      bestClass = i;
    }
  }

  return bestClass;
}

void updateStableAction(int newPred) {
  if (newPred == stableClass) {
    candidateClass = -1;
    candidateCount = 0;
    return;
  }

  if (newPred == candidateClass) {
    candidateCount++;
  } else {
    candidateClass = newPred;
    candidateCount = 1;
  }

  if (candidateCount >= CHANGE_CONFIRM_COUNT) {
    stableClass = candidateClass;

    candidateClass = -1;
    candidateCount = 0;

    showCurrentState();
    lastOngoingPrint = millis();
  }
}

void printOngoingStatus() {

  if (stableClass == 2) return;

  unsigned long now = millis();

  if (now - lastOngoingPrint >= ONGOING_INTERVAL) {

    switch (stableClass) {
      case 0:
        Serial.println("ROTATING...");
        break;
      case 1:
        Serial.println("SHAKING...");
        break;
      case 3:
        Serial.println("TRANSLATING...");
        break;
    }

    lastOngoingPrint = now;
  }
}

void showCurrentState() {
  if (stableClass == 2) {
    Serial.println("Now STILL");
  } else {
    Serial.print("Action: ");
    Serial.println(className(stableClass));
  }

  drawActionScreen(stableClass);
}

void setup() {
  Serial.begin(115200);
  delay(1000);

  setupScreen();
  drawActionScreen(stableClass);

  Wire.begin(6, 7);
  setupIMU();

  float ax, ay, az, gx, gy, gz;
  readIMU(ax, ay, az, gx, gy, gz);

  fax = ax; fay = ay; faz = az;
  fgx = gx; fgy = gy; fgz = gz;
  gravx = ax; gravy = ay; gravz = az;

  float lin_ax = ax - gravx;
  float lin_ay = ay - gravy;
  float lin_az = az - gravz;

  float initGyroMag = sqrt(fgx * fgx + fgy * fgy + fgz * fgz);
  float initLinAccMag = sqrt(lin_ax * lin_ax + lin_ay * lin_ay + lin_az * lin_az);

  lastGyroMag = initGyroMag;
  lastLinAccMag = initLinAccMag;

  for (int i = 0; i < WINDOW_SIZE; i++) {
    gyroWindow[i] = initGyroMag;
    linAccWindow[i] = initLinAccMag;
    linAxWindow[i] = lin_ax;
    linAyWindow[i] = lin_ay;
    linAzWindow[i] = lin_az;
  }

  for (int i = 0; i < VOTE_SIZE; i++) {
    predBuffer[i] = 2;
  }

  Serial.println("System ready.");
  showCurrentState();
}

void loop() {
  float ax, ay, az, gx, gy, gz;
  readIMU(ax, ay, az, gx, gy, gz);

  fax = alpha * ax + (1.0f - alpha) * fax;
  fay = alpha * ay + (1.0f - alpha) * fay;
  faz = alpha * az + (1.0f - alpha) * faz;

  fgx = alpha * gx + (1.0f - alpha) * fgx;
  fgy = alpha * gy + (1.0f - alpha) * fgy;
  fgz = alpha * gz + (1.0f - alpha) * fgz;

  gravx = gravityAlpha * fax + (1.0f - gravityAlpha) * gravx;
  gravy = gravityAlpha * fay + (1.0f - gravityAlpha) * gravy;
  gravz = gravityAlpha * faz + (1.0f - gravityAlpha) * gravz;

  float lin_ax = fax - gravx;
  float lin_ay = fay - gravy;
  float lin_az = faz - gravz;

  float lin_acc_mag = sqrt(lin_ax * lin_ax + lin_ay * lin_ay + lin_az * lin_az);
  float gyro_mag = sqrt(fgx * fgx + fgy * fgy + fgz * fgz);

  float gyro_diff = fabs(gyro_mag - lastGyroMag);
  float lin_acc_diff = fabs(lin_acc_mag - lastLinAccMag);

  lastGyroMag = gyro_mag;
  lastLinAccMag = lin_acc_mag;

  gyroWindow[windowIndex] = gyro_mag;
  linAccWindow[windowIndex] = lin_acc_mag;
  linAxWindow[windowIndex] = lin_ax;
  linAyWindow[windowIndex] = lin_ay;
  linAzWindow[windowIndex] = lin_az;

  windowIndex++;
  if (windowIndex >= WINDOW_SIZE) {
    windowIndex = 0;
    windowFilled = true;
  }

  if (!windowFilled) {
    delay(100);
    return;
  }

  float gyro_avg = 0.0f;
  float lin_acc_avg = 0.0f;
  float lin_ax_avg = 0.0f;
  float lin_ay_avg = 0.0f;
  float lin_az_avg = 0.0f;

  for (int i = 0; i < WINDOW_SIZE; i++) {
    gyro_avg += gyroWindow[i];
    lin_acc_avg += linAccWindow[i];
    lin_ax_avg += linAxWindow[i];
    lin_ay_avg += linAyWindow[i];
    lin_az_avg += linAzWindow[i];
  }

  gyro_avg /= WINDOW_SIZE;
  lin_acc_avg /= WINDOW_SIZE;
  lin_ax_avg /= WINDOW_SIZE;
  lin_ay_avg /= WINDOW_SIZE;
  lin_az_avg /= WINDOW_SIZE;

  float gyro_var = 0.0f;
  float lin_acc_var = 0.0f;

  for (int i = 0; i < WINDOW_SIZE; i++) {
    float dg = gyroWindow[i] - gyro_avg;
    float da = linAccWindow[i] - lin_acc_avg;
    gyro_var += dg * dg;
    lin_acc_var += da * da;
  }

  gyro_var /= WINDOW_SIZE;
  lin_acc_var /= WINDOW_SIZE;

  float features[FEATURE_COUNT] = {
    fgx, fgy, fgz,
    lin_acc_mag,
    gyro_mag,
    gyro_diff,
    lin_acc_diff,
    gyro_avg,
    gyro_var,
    lin_acc_avg,
    lin_acc_var,
    lin_ax_avg,
    lin_ay_avg,
    lin_az_avg
  };

  int pred;
  if (
    gyro_avg < 35 &&
    gyro_var < 120 &&
    lin_acc_avg < 0.12 &&
    lin_acc_var < 0.04
   ) {
      pred = 2;   // STILL
  }
  else
  {
      pred = predictClass(features);
  }

  int smoothPred = majorityVote(pred);

  updateStableAction(smoothPred);
  printOngoingStatus();
  updateScreen();

  delay(10);
}